## conf/distro/qcom-robotics-distro-catchall.conf
```bitbake
# Copyright (c) 2025 Qualcomm Innovation Center, Inc. All rights reserved.
# SPDX-License-Identifier: BSD-3-Clause-Clear

require conf/distro/qcom-distro-catchall.conf
require conf/distro/include/qcom-robotics-sdk.inc

DISTRO_FEATURES:append = " ros2-jazzy"

DISTRO_NAME = "Qualcomm Linux Robotics Reference Distro with ROS(SOTA and SELinux enabled)"
```

## conf/distro/qcom-robotics-distro-sota.conf
```bitbake
# Copyright (c) 2025 Qualcomm Innovation Center, Inc. All rights reserved.
# SPDX-License-Identifier: BSD-3-Clause-Clear

require conf/distro/qcom-robotics-ros2-jazzy.conf
require conf/distro/qcom-distro-sota.conf
```

## conf/distro/qcom-robotics-ros2-jazzy.conf
```bitbake
# Copyright (c) 2025 Qualcomm Innovation Center, Inc. All rights reserved.
# SPDX-License-Identifier: BSD-3-Clause-Clear

require conf/distro/include/qcom-robotics-sdk.inc
# require conf/distro/qcom-wayland.conf

DISTRO_NAME = "QCOM Robotics Reference Distro with ROS"

DISTRO_FEATURES:append = " ros2-jazzy"
```
